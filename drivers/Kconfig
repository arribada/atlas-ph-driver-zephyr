## drivers/Kconfig
```kconfig
# Copyright (c) 2024 Arribada Initiative CIC
# SPDX-License-Identifier: MIT

menu "Drivers"
rsource "sensor/Kconfig"
endmenu
```

## drivers/sensor/Kconfig
```kconfig
# Copyright (c) 2024 Arribada Initiative CIC
# SPDX-License-Identifier: MIT

if SENSOR
rsource "oemph/Kconfig"
endif #SENSOR
```

## drivers/sensor/oemec/Kconfig
```kconfig
menuconfig OEMEC
    bool "Enable OEMEC"
    default y
    depends on DT_HAS_ATLAS_OEMEC_ENABLED
    select I2C
    help
	OEM EC sensor from Atlas
```

## drivers/sensor/oemph/Kconfig
```kconfig
menuconfig OEMPH
    bool "Enable OEMPH"
    default y
    depends on DT_HAS_ATLAS_OEMPH_ENABLED
    select I2C
    help
	OEM PH sensor from Atlas
```

## dts/bindings/sensor/atlas,oemec.yaml
```yaml
# Copyright (c) 2025 Arribada Initiative CIC
# SPDX-License-Identifier: MIT
description: Atlas OEM-EC control board

compatible: "atlas,oemec"

include: [sensor-device.yaml, i2c-device.yaml]


# TODO - add int-gpios/sqw, clock, etc.
```

## dts/bindings/sensor/atlas,oemph.yaml
```yaml
# Copyright (c) 2025 Arribada Initiative CIC
# SPDX-License-Identifier: MIT
description: Atlas OEM-PH control board

compatible: "atlas,oemph"

include: [sensor-device.yaml, i2c-device.yaml]


# TODO - add int-gpios/sqw, clock, etc.
```

## examples/simple/build/Kconfig/Kconfig.modules
```kconfig
menu "atlas-driver-zephyr (/home/anuj/arribada/atlas-workplace/atlas-driver-zephyr)"
osource "/home/anuj/arribada/atlas-workplace/atlas-driver-zephyr/Kconfig"
config ZEPHYR_ATLAS_DRIVER_ZEPHYR_MODULE
	bool
	default y
endmenu
menu "cmsis (/home/anuj/arribada/atlas-workplace/modules/hal/cmsis)"
osource "$(ZEPHYR_CMSIS_KCONFIG)"
config ZEPHYR_CMSIS_MODULE
	bool
	default y
endmenu
menu "hal_rpi_pico (/home/anuj/arribada/atlas-workplace/modules/hal/rpi_pico)"
osource "$(ZEPHYR_HAL_RPI_PICO_KCONFIG)"
config ZEPHYR_HAL_RPI_PICO_MODULE
	bool
	default y
endmenu
```
